## main/Kconfig.projbuild
```kconfig
menu "Roboteye network"

config ROBOTEYE_WIFI_SSID
    string "Roboteye Wi-Fi SSID"
    default ""

config ROBOTEYE_WIFI_PASSWORD
    string "Roboteye Wi-Fi password"
    default ""

endmenu
```
